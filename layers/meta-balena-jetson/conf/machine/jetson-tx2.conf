## layers/meta-balena-jetson/conf/machine/jetson-tx2.conf
```bitbake
#@TYPE: Machine
##@NAME: jetson-xavier
##@DESCRIPTION: Machine configuration for the Jetson Xavier AGX Devkit

MACHINEOVERRIDES = "jetson-tx2-devkit:${MACHINE}"
include conf/machine/jetson-tx2-devkit.conf

MACHINEOVERRIDES := "${@'${MACHINEOVERRIDES}'.replace(':${MACHINE}',':jetson-tx2-devkit:${MACHINE}')}"
```
